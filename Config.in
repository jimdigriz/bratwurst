## Config.in
```kconfig
source "$BR2_EXTERNAL/package/linux-atm/Config.in"
source "$BR2_EXTERNAL/package/ar7-atm/Config.in"

menu "Host utilities"

	source "$BR2_EXTERNAL/package/srecord/Config.in.host"
	source "$BR2_EXTERNAL/package/srec2bin/Config.in.host"
	source "$BR2_EXTERNAL/package/addpattern/Config.in.host"

endmenu
```

## package/addpattern/Config.in.host
```kconfig
config BR2_PACKAGE_HOST_ADDPATTERN
	bool "host addpattern"
	help
	  addpattern tool used in generating images for the adam2 bootloader

	  http://git.openwrt.org/?p=openwrt.git;a=tree;f=tools/firmware-utils/src
```

## package/ar7-atm/Config.in
```kconfig
config BR2_PACKAGE_AR7_ATM
	bool "TI Sangam ATM driver"
	depends on BR2_LINUX_KERNEL
	help
          build and include the TI Sangam ATM driver as found on the
	  Linksys WAG54Gv2.

	  Patches and tarball from OpenWRT:package/kernel/ar7-atm.

comment "TI Sangam ATM driver needs a Linux kernel to be built"
        depends on !BR2_LINUX_KERNEL
```

## package/external-libmnl/Config.in
```kconfig
config BR2_PACKAGE_EXTERNAL_LIBMNL
	bool "external-libmnl"
	depends on BR2_LARGEFILE
	help
	  libmnl is a minimalistic user-space library oriented
	  to Netlink developers.

	  http://netfilter.org/projects/libmnl/

comment "external-libmnl needs a toolchain w/ largefile"
	depends on !BR2_LARGEFILE
```

## package/linux-atm/Config.in
```kconfig
config BR2_PACKAGE_LINUX_ATM
	bool "Linux ATM"
	select BR2_PACKAGE_FLEX
	help
	  Linux ATM provides the userspace tools to manage ATM interfaces.

	  http://linux-atm.sourceforge.net/
```

## package/mktplinkfw2/Config.in.host
```kconfig
config BR2_PACKAGE_HOST_MKTPLINKFW2
	bool "host mktplinkfw2"
	help
	  mktplinkfw2 tool used in generating images for TP-Link bootloaders

	  http://git.openwrt.org/?p=openwrt.git;a=tree;f=tools/firmware-utils/src
```

## package/srec2bin/Config.in.host
```kconfig
config BR2_PACKAGE_HOST_SREC2BIN
	bool "host srec2bin"
	help
	  srec2bin tool used in generating images for the adam2 bootloader

	  http://git.openwrt.org/?p=openwrt.git;a=tree;f=tools/firmware-utils/src
```

## package/srecord/Config.in.host
```kconfig
config BR2_PACKAGE_HOST_SRECORD
	bool "host srecord"
	help
	  The SRecord package is a collection of powerful tools for manipulating EPROM load files. 

	  http://srecord.sourceforge.net/
```
